## drivers/block/zram/Kconfig
```kconfig
config ZRAM
	tristate "Compressed RAM block device support"
	depends on BLOCK && SYSFS && ZSMALLOC && CRYPTO
	select CRYPTO_LZO
	default n
	help
	  Creates virtual block devices called /dev/zramX (X = 0, 1, ...).
	  Pages written to these disks are compressed and stored in memory
	  itself. These disks allow very fast I/O and compression provides
	  good amounts of memory savings.

	  It has several use cases, for example: /tmp storage, use as swap
	  disks and maybe many more.

	  See Documentation/blockdev/zram.txt for more information.

config ZRAM_WRITEBACK
       bool "Write back incompressible page to backing device"
       depends on ZRAM
       default n
       help
	 With incompressible page, there is no memory saving to keep it
	 in memory. Instead, write it out to backing device.
	 For this feature, admin should set up backing device via
	 /sys/block/zramX/backing_dev.

	 See Documentation/blockdev/zram.txt for more information.

config ZRAM_MEMORY_TRACKING
	bool "Track zRam block status"
	depends on ZRAM && DEBUG_FS
	help
	  With this feature, admin can track the state of allocated blocks
	  of zRAM. Admin could see the information via
	  /sys/kernel/debug/zram/zramX/block_state.

	  See Documentation/blockdev/zram.txt for more information.

config ZRAM_BACKEND_LZ4KDR
	bool "lz4kdr compression support"
	depends on ZRAM
	default n
	select LZ4KDR_COMPRESS
	select LZ4KDR_DECOMPRESS
	help
	  LZ4KDR is a speed-tuned derivative of Huawei's LZ4KD (a
	  zram-oriented LZ4 variant), wire-compatible with the original
	  LZ4KD encoding but with a reworked encoder search loop. See
	  include/linux/lz4kdr.h for the attribution and what changed.

	  Adds "lz4kdr" to the list of compressors that can be selected
	  via /sys/block/zramX/comp_algorithm. It is NOT the default:
	  CONFIG_ZRAM_DEFAULT_COMP_ALGORITHM stays untouched.

	  Note that the codec encodes at most one 4KB block per call,
	  so this is only meaningful on PAGE_SIZE == 4096 kernels.

config ZRAM_DEFAULT_COMP_ALGORITHM
	string "Default ZRAM algorithm"
	default "lzo"
```

## drivers/net/rekernel/Kconfig
```kconfig
menu "Re:Kernel"

config REKERNEL
	tristate "Re:Kernel support"
	default y
	help
	  Make tombstone users get a better experience by reporting
	  binder/signal activity against frozen (cached) processes to
	  userspace via netlink.

config REKERNEL_DEBUG
	bool "Re:Kernel debug logging"
	depends on REKERNEL
	default n

endmenu
```
